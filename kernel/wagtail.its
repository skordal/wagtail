## kernel/wagtail.its
```
/* Wagtail OS
   (c) Kristian Klomsten Skordal 2012 <kristian.skordal@gmail.com>
   Report bugs and issues on <http://github.com/skordal/wagtail>
*/

/dts-v1/;

/ {
	description = "Wagtail OS";
	
	images {
		kernel@1 {
			description = "Wagtail OS Kernel";
			data = /incbin/("./wagtail.bin.gz");
			type = "kernel";
			arch = "arm";
			os = "linux";
			compression = "gzip";
			load = <0x81000000>;
			entry = <0x81000000>;
		};
	};

	configurations {
		default = "config@1";
		config@1 {
			description = "Boot Wagtail OS";
			kernel = "kernel@1";
		};
	};
};
```
